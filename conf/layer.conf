## conf/machine/include/rcar_gen4_common.inc
```bitbake
SOC_FAMILY =. "rcar-gen4:"

require conf/machine/include/rcar_common.inc

WKS_FILE ?= "rcar-singlepart-noloader.wks"

IMAGE_FSTYPES += " ext4 wic.gz"
```

## conf/machine/sparrow-hawk.conf
```bitbake
#@TYPE: Machine
#@NAME: Sparrow hawk machine
#@DESCRIPTION: Machine configuration for running sparrow-hawk

SOC_FAMILY = "r8a779g3"
require conf/machine/include/rcar_gen4_common.inc
# u-boot
PREFERRED_VERSION_u-boot = "v2025.07+git%"

DEFAULTTUNE ?= "cortexa76"
require conf/machine/include/arm/armv8-2a/tune-cortexa76.inc

# Device tree
KERNEL_DEVICETREE = "\
    renesas/r8a779g3-sparrow-hawk.dtb \
"

# u-boot configure
UBOOT_MACHINE = "r8a779g3_sparrowhawk_defconfig"
```
